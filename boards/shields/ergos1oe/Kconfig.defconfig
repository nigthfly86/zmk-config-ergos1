## boards/shields/ergos1oe/Kconfig.defconfig
```kconfig
if SHIELD_ERGOS1OE_LEFT

# Name must be less than 16 characters long!
config ZMK_KEYBOARD_NAME
    default "ergos1oe"

config ZMK_SPLIT_ROLE_CENTRAL
    default y

endif

if SHIELD_ERGOS1OE_LEFT || SHIELD_ERGOS1OE_RIGHT

config ZMK_SPLIT
    default y

endif
```

## boards/shields/ergos1oe/Kconfig.shield
```kconfig
# No whitespace after the comma or in your part name!
config SHIELD_ERGOS1OE_LEFT
    def_bool $(shields_list_contains,ergos1oe_left)

# No whitespace after the comma or in your part name!
config SHIELD_MY_ERGOS1OE_RIGHT
    def_bool $(shields_list_contains,ergos1oe_right)
```
